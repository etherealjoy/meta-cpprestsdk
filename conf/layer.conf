## conf/layer.conf
```bitbake
# We have a conf and classes directory, append to BBPATH
BBPATH .= ":${LAYERDIR}"

# We have recipes-* directories, add to BBFILES
BBFILES += "${LAYERDIR}/recipes-*/*/*.bb 	\
            ${LAYERDIR}/recipes-*/*/*.bbappend"

BBFILE_COLLECTIONS += "cpprestsdk-layer"

BBFILE_PATTERN_cpprestsdk-layer := "^${LAYERDIR}/"

BBFILE_PRIORITY_cpprestsdk-layer = "5"

# Custom licenses used by some packages in this layer
LICENSE_PATH += "${LAYERDIR}"

# This should only be incremented on significant changes that will
# cause compatibility issues with other layers
LAYERVERSION_cpprestsdk-layer = "1"

LAYERDEPENDS_cpprestsdk-layer = "core"
```
